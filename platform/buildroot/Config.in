## platform/buildroot/Config.in
```kconfig
source "$BR2_EXTERNAL_OPEN_MIMIC_PATH/package/juce-framework/Config.in"
source "$BR2_EXTERNAL_OPEN_MIMIC_PATH/package/open-mimic/Config.in"
source "$BR2_EXTERNAL_OPEN_MIMIC_PATH/package/mimic-input-abi/Config.in"
```

## platform/buildroot/configs/open_mimic_defconfig
```kconfig
BR2_arm=y
BR2_cortex_a15=y
BR2_ARM_EABIHF=y
BR2_KERNEL_HEADERS_VERSION=y
BR2_DEFAULT_KERNEL_VERSION="4.1.13"
BR2_PACKAGE_HOST_LINUX_HEADERS_CUSTOM_4_1=y
BR2_TOOLCHAIN_BUILDROOT_MUSL=y
BR2_TOOLCHAIN_BUILDROOT_CXX=y
BR2_TARGET_GENERIC_HOSTNAME="open-mimic"
BR2_TARGET_GENERIC_ISSUE="Open Mimic Buildroot"
BR2_TARGET_GENERIC_ROOT_PASSWD=""
# BR2_TARGET_GENERIC_GETTY is not set
BR2_ROOTFS_DEVICE_CREATION_DYNAMIC_EUDEV=y
BR2_ROOTFS_OVERLAY="$(BR2_EXTERNAL_OPEN_MIMIC_PATH)/overlay"
BR2_GLOBAL_PATCH_DIR="$(BR2_EXTERNAL_OPEN_MIMIC_PATH)/patches"
BR2_ROOTFS_POST_BUILD_SCRIPT="$(BR2_EXTERNAL_OPEN_MIMIC_PATH)/post-build.sh"
BR2_PACKAGE_DROPBEAR=y
BR2_PACKAGE_DROPBEAR_DISABLE_REVERSEDNS=y
BR2_PACKAGE_WPA_SUPPLICANT=y
BR2_PACKAGE_WPA_SUPPLICANT_NL80211=y
BR2_PACKAGE_WPA_SUPPLICANT_WEXT=y
BR2_PACKAGE_WPA_SUPPLICANT_CLI=y
BR2_PACKAGE_BLUEZ5_UTILS=y
BR2_PACKAGE_BLUEZ5_UTILS_CLIENT=y
BR2_PACKAGE_BLUEZ5_UTILS_TOOLS=y
BR2_PACKAGE_OPEN_MIMIC=y
BR2_PACKAGE_XORG7=y
BR2_PACKAGE_XSERVER_XORG_SERVER=y
BR2_PACKAGE_XSERVER_XORG_SERVER_MODULAR=y
BR2_PACKAGE_XDRIVER_XF86_VIDEO_FBDEV=y
BR2_PACKAGE_XDRIVER_XF86_INPUT_EVDEV=y
BR2_PACKAGE_XAPP_XKBCOMP=y
BR2_PACKAGE_XAPP_XAUTH=y
BR2_PACKAGE_DEJAVU=y
# BR2_PACKAGE_DEJAVU_MONO is not set
# BR2_PACKAGE_DEJAVU_SERIF is not set
# BR2_PACKAGE_DEJAVU_SANS_CONDENSED is not set
# BR2_PACKAGE_DEJAVU_SERIF_CONDENSED is not set
BR2_TARGET_ROOTFS_EXT2=y
BR2_TARGET_ROOTFS_EXT2_4=y
BR2_TARGET_ROOTFS_EXT2_LABEL="OPENMIMIC"
BR2_TARGET_ROOTFS_EXT2_SIZE="256M"
BR2_TARGET_ROOTFS_EXT2_MKFS_OPTIONS="-O ^64bit,^metadata_csum,^orphan_file"
# BR2_TARGET_ROOTFS_TAR is not set
```

## platform/buildroot/package/litert-runtime/Config.in
```kconfig
config BR2_PACKAGE_LITERT_RUNTIME
	bool "LiteRT CPU runtime"
	depends on BR2_INSTALL_LIBSTDCPP
	depends on BR2_TOOLCHAIN_HAS_THREADS
	depends on !BR2_STATIC_LIBS
	help
	  Google LiteRT CompiledModel C API, CPU backend for ARMv7/musl.
```

## platform/buildroot/package/mimicd/Config.in
```kconfig
config BR2_PACKAGE_MIMICD
	bool "mimicd"
	depends on BR2_PACKAGE_HOST_RUSTC_TARGET_ARCH_SUPPORTS
	select BR2_PACKAGE_HOST_RUSTC
	help
	  Read-only ADC layout probe and diagnostic DMA snapshots.
```

## platform/buildroot/package/open-mimic/Config.in
```kconfig
config BR2_PACKAGE_OPEN_MIMIC
	bool "Open Mimic C++ applications"
	depends on BR2_INSTALL_LIBSTDCPP
	depends on BR2_TOOLCHAIN_HAS_THREADS
	depends on !BR2_STATIC_LIBS
	select BR2_PACKAGE_LITERT_RUNTIME
	select BR2_PACKAGE_JUCE_FRAMEWORK
	select BR2_PACKAGE_FREETYPE
	select BR2_PACKAGE_FONTCONFIG
	select BR2_PACKAGE_XLIB_LIBX11
	select BR2_PACKAGE_XLIB_LIBXCOMPOSITE
	select BR2_PACKAGE_XLIB_LIBXEXT
	select BR2_PACKAGE_XLIB_LIBXRENDER
	select BR2_PACKAGE_XLIB_LIBXI
	help
	  JUCE instrument interface and headless ADC/audio engine foundation.
```
